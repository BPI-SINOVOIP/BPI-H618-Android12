## longan/brandy/brandy-2.0/u-boot-2018/drivers/video/sunxi/disp2/disp/lcd/Kconfig
```kconfig
config LCD_SUPPORT_GG1P4062UTSW
	bool "LCD support cpu_gg1p4062utsw panel"
	default n
	---help---
		If you want to support cpu_gg1p4062utsw panel for display driver, select it.

config LCD_SUPPORT_DX0960BE40A1
	bool "LCD support dx0960be40a1 panel"
	default n
	---help---
		If you want to support dx0960be40a1 panel for display driver, select it.

config LCD_SUPPORT_TFT720X1280
	bool "LCD support dx0960be40a1 panel"
	default n
	---help---
		If you want to support dx0960be40a1 panel for display driver, select it.

config LCD_SUPPORT_FD055HD003S
	bool "LCD support fd055hd003s panel"
	default n
	---help---
		If you want to support fd055hd003s panel for display driver, select it.

config LCD_SUPPORT_HE0801A068
	bool "LCD support he0801a068 panel"
	default y
	---help---
		If you want to support he0801a068 panel for display driver, select it.

config LCD_SUPPORT_ILI9341
	bool "LCD support ili9341 panel"
	default n
	---help---
		If you want to support ili9341 panel for display driver, select it.

config LCD_SUPPORT_LH219WQ1
	bool "LCD support LH219WQ1 panel"
	default n
	---help---
		If you want to support LH219WQ1 panel for display driver, select it.

config LCD_SUPPORT_LS029B3SX02
	bool "LCD support ls029b3sx02 panel"
	default n
	---help---
		If you want to support ls029b3sx02 panel for display driver, select it.

config LCD_SUPPORT_LT070ME05000
	bool "LCD support lt070me05000 panel"
	default n
	---help---
		If you want to support lt070me05000 panel for display driver, select it.


config LCD_SUPPORT_S6D7AA0X01
	bool "LCD support S6D7AA0X01 panel"
	default n
	---help---
		If you want to support S6D7AA0X01 panel for display driver, select it.


config LCD_SUPPORT_T27P06
	bool "LCD support t27p06 panel"
	default n
	---help---
		If you want to support t27p06 panel for display driver, select it.

config LCD_SUPPORT_TFT720x1280
	bool "LCD support tft720x1280 panel"
	default n
	---help---
		If you want to support tft720x1280 panel for display driver, select it.


config LCD_SUPPORT_WTQ05027D01
	bool "LCD support wtq05027d01 panel"
	default n
	---help---
		If you want to support wtq05027d01 panel for display driver, select it.

config LCD_SUPPORT_H245QBN02
	bool "LCD support H245QBN02 panel"
	default n
	---help---
		If you want to support H245QBN02 panel for display driver, select it.

config LCD_SUPPORT_ST7789V
	bool "LCD support ST7789V panel"
	default n
	---help---
		If you want to support ST7789V panel for display driver, select it.

config LCD_SUPPORT_ST7796S
	bool "LCD support ST7796S panel"
	default n
	---help---
		If you want to support ST7796S panel for display driver, select it.

config LCD_SUPPORT_ST7701S
	bool "LCD support ST7701S panel"
	default n
	---help---
		If you want to support ST7701S panel for display driver, select it.

config LCD_SUPPORT_ST7701S_G5
	bool "LCD support ST7701S_G5 panel"
	default n
	help
		If you want to support ST7701S_G5 panel for display driver, select it.

config LCD_SUPPORT_T30P106
	bool "LCD support T30P106 panel"
	default n
	---help---
		If you want to support T30P106 panel for display driver, select it.

config LCD_SUPPORT_TO20T20000
	bool "LCD support TO20T20000 panel"
	default n
	---help---
		If you want to support TO20T20000 panel for display driver, select it.

config LCD_SUPPORT_FRD450H40014
	bool "LCD support FRD450H40014 panel"
	default n
	---help---
		If you want to support FRD450H40014 panel for display driver, select it.

config LCD_SUPPORT_S2003T46G
	bool "LCD support S2003T46G panel"
	default n
	---help---
		If you want to support S2003T46G panel for display driver, select it.

config LCD_SUPPORT_WILLIAMLCD
	bool "LCD support WilliamLcd panel"
	default y
	---help---
		If you want to support WilliamLcd panel for display driver, select it.

config LCD_SUPPORT_LQ101R1SX03
	bool "LCD support lq101r1sx03 panel"
	default y
	---help---
		If you want to support lq101r1sx03 panel for display driver, select it.

config LCD_SUPPORT_INET_DSI_PANEL
	bool "LCD support inet_dsi_panel panel"
	default y
	---help---
		If you want to support inet_dsi_panel panel for display driver, select it.

config LCD_SUPPORT_WTL096601G03
	bool "LCD support WTL096601G03 panel"
	default n
	---help---
		If you want to support WTL096601G03 panel for display driver, select it.

config LCD_SUPPORT_BP101WX1
	bool "LCD support BP101WX1 panel"
	default n
	---help---
		If you want to support BP101WX1 panel for display driver, select it.

config LCD_SUPPORT_M133X56
	bool "LCD support M133X56 panel"
	default n
	---help---
		If you want to support M133X56 panel for display driver, select it.

config LCD_SUPPORT_K101IM2QA04
	bool "LCD support K101IM2QA04 panel"
	default n
	---help---
		If you want to support K101IM2QA04 panel for display driver, select it.

config LCD_SUPPORT_K101_MM2QA01_A
	bool "LCD support K101_MM2QA01_A panel"
	default n
	---help---
		If you want to support K101_MM2QA01_A panel for display driver, select it.

config LCD_SUPPORT_K101IM2BYL02L
	bool "LCD support K101IM2BYL02L"
	default n
	---help---
		If you want to support K101IM2BYL02L panel for display driver, select it.

config LCD_SUPPORT_FX070
	bool "LCD support fx070 panel"
	default n
	---help---
		If you want to support fx070 panel for display driver, select it.

config LCD_SUPPORT_M101B31
	bool "LCD support m101b31 panel"
	default n
	help
		If you want to support m101b31 panel for display driver, select it.

config LCD_SUPPORT_CC08021801_310_800X1280
	bool "LCD support CC08021801_310_800X1280 panel"
	default y
	---help---
		If you want to support CC08021801_310_800X1280 panel for display driver, select it.

config LCD_SUPPORT_KD101NA5
	bool "LCD support kd101na5 panel"
	default n
	---help---
		If you want to support kd101na5 panel for display driver, select it.

config LCD_SUPPORT_KD070D57
	bool "LCD support kd070d57 panel"
	default n
	---help---
		If you want to support kd070d57 panel for display driver, select it.

config LCD_SUPPORT_ZS080NI4003E7H3H_A
	bool "LCD support zs080ni4003e7h3h_a panel"
	default n
	---help---
		If you want to support zs080ni4003e7h3h_a panel for display driver, select it.

config LCD_SUPPORT_K080_IM2HYL802R_800X1280
	bool "LCD support K080_IM2HYL802R_800X1280 panel"
	default n
	---help---
		If you want to support K080_IM2HYL802R_800X1280 panel for display driver, select it.

config LCD_SUPPORT_K101_IM2BYL02_L_800X1280
	bool "LCD support K101_IM2BYL02_L_800X1280 panel"
	default n
	---help---
		if you want to support K101_IM2BYL02_L_800X1280 panel for display driver, select it.

config LCD_SUPPORT_JD9366AB_3
	bool "LCD support JD9366AB_3 panel"
	default n
	---help---
		If you want to support JD9366AB_3 panel for display driver, select it.

config LCD_SUPPORT_JD9161Z_MIPI
	bool "LCD support mipi_jd9161z panel"
	default n
	help
		If you want to support mipi_jd9161z panel for display driver, select it.

config LCD_SUPPORT_TFT08006
	bool "LCD support TFT08006 panel"
	default n
	---help---
		If you want to support TFT08006 panel for display driver, select it.

config LCD_SUPPORT_T050K589
	bool "LCD support T050K589 panel"
	default y
	---help---
		If you want to support T050K589 panel for display driver, select it.

config LCD_SUPPORT_ICN6202
	bool "LCD support icn6202 panel"
	default n
	---help---
		If you want to support icn6202 panel for display driver, select it.

config LCD_SUPPORT_NT35510_MIPI
	bool "LCD support NT35510_mipi panel"
	default n
	---help---
		If you want to support NT35510 panel for display driver, select it.

config LCD_SUPPORT_FT8021_TV097WXM_LH0
	bool "LCD FT8021_TV097WXM_LH0 panel"
	default n
	---help---
		if you want to support FT8021_TV097WXM_LH0 panel for display driver, select it.

config LCD_SUPPORT_JD9365DA_SAT080BO31I21Y03_26114M018I
	bool "LCD support JD9365DA_SAT080BO31I21Y03_26114M018I panel"
	default n
	---help---
		if you want to support JD9365DA_SAT080BO31I21Y03_26114M018I panel for display driver, select it.

config LCD_SUPPORT_JD9365DA_SAT080AT31I21Y03_26114M019IB
	bool "LCD support JD9365DA_SAT080AT31I21Y03_26114M019IB panel"
	default n
	---help---
		if you want to support JD9365DA_SAT080AT31I21Y03_26114M019IB panel for display driver, select it.

config LCD_SUPPORT_JD9365DA_SQ101A_B4EI313_39R501
	bool "LCD support JD9365DA_SQ101A_B4EI313_39R501 panel"
	default n
	---help---
		if you want to support JD9365DA_SQ101A_B4EI313_39R501 panel for display driver, select it.

config LCD_SUPPORT_KD080D24
	bool "LCD support kd080d24 panel"
	default y
	---help---
		If you want to support he0801a068 panel for display driver, select it.

config LCD_SUPPORT_B080UAN01_MIPI1200X1920
	bool "LCD support b080uan01 mipi 1200x1920 panel"
	default n
	---help---
		If you want to support T050K589 panel for display driver, select it.

config LCD_SUPPORT_FX070_DHM18BOEL2_1024X600
	bool "LCD support FX070_DHM18BOEL2_1024X600 panel"
	default y
	---help---
		If you want to support FX070_DHM18BOEL2_1024X600 panel for display driver, select it.
```

## longan/brandy/brandy-2.0/u-boot-2018/drivers/video/sunxi/disp2/edp2/lowlevel/Kconfig
```kconfig
# SPDX-License-Identifier: GPL-2.0-or-later
config AW_EDP2_PHY_USED
    def_bool n
    depends on (EDP2_DISP2_SUNXI)
    default n
    help
        Selected when aw edp phy used.

config DISP_PHY_INNO_EDP_1_3
    tristate "support innosilicon eDP 1.3 phy"
    depends on (EDP2_DISP2_SUNXI)
    select AW_EDP2_PHY_USED
    default n
    help
        Innosilicon eDP 1.3 phy for Allwinner eDP module.
```

## longan/brandy/brandy-2.0/u-boot-2018/drivers/video/sunxi/disp2/edp2/panels/Kconfig
```kconfig
# SPDX-License-Identifier: GPL-2.0-or-later
config EDP2_SUPPORT_VVX10T025J00_2560X1600
    tristate "eDP panel support VVX10T025J00_2560X1600"
    depends on (EDP2_DISP2_SUNXI)
    default n
    help
        If you want to support VVX10T025J00_2560X1600 panel for edp2 driver, select it.
```
