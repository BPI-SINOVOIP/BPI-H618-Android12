## device/google/trout/agl_services_build/yocto-layer/meta-google/conf/layer.conf
```bitbake
BBPATH .= ":${LAYERDIR}"

BBFILES += "${LAYERDIR}/recipes-*/*/*.bb \
            ${LAYERDIR}/recipes-*/*/*.bbappend"

BBFILE_COLLECTIONS += "meta-google"
BBFILE_PATTERN_meta-google = "^${LAYERDIR}/"
BBFILE_PRIORITY_meta-google = "6"

LAYERDEPENDS_meta-google = "clang-layer"
```

## longan/brandy/arisc/ar100s/driver/Kconfig
```kconfig
menu "Device Drivers"

source "driver/pmu/Kconfig"

source "driver/twi/Kconfig"

source "driver/hwmsgbox/Kconfig"

source "driver/timer/Kconfig"

source "driver/watchdog/Kconfig"

source "driver/ir/Kconfig"

source "driver/dram/Kconfig"

endmenu
```

## longan/brandy/arisc/ar100s/driver/hwmsgbox/Kconfig
```kconfig
config MSGBOX_USED
	def_bool y
	prompt "MSGBOX used"

choice MSGBOX_IP
	prompt "Sunxi msgbox to use"
	depends on MSGBOX_USED

	config HW_MSGBOX_USED
	bool
	prompt "Old IP MSGBOX used"
	depends on MSGBOX_USED

	config HW_MSGBOX_EXTENDED_USED
	bool
	prompt "New IP MSGBOX used"
	depends on MSGBOX_USED
endchoice

config HW_MSGBOX_AMP_USED
	bool
	prompt "General MSGBOX base on rpmsg"
	depends on MSGBOX_USED
	def_bool n
```

## longan/brandy/arisc/ar100s/service/Kconfig
```kconfig
menu "Services"


config STANDBY_SERVICE
	def_bool y
	prompt "Standby service support"

config FDT_USED
	def_bool y
	prompt "fdt lib support"

config FDT_INIT_ARISC_USED
	def_bool n
	depends on FDT_USED
	prompt "init arisc module from fdt support"

endmenu
```

## longan/brandy/brandy-2.0/u-boot-2018/configs/sun55iw3p1_ft_defconfig
```kconfig
CONFIG_ARM=y
CONFIG_ARCH_SUNXI=y
CONFIG_MACH_SUN55IW3=y
CONFIG_SUNXI_GPIO_V2=y
#CONFIG_AXP_GPIO=y
CONFIG_DEFAULT_DEVICE_TREE="sun55iw3p1-soc-system"
# CONFIG_SYS_MALLOC_CLEAR_ON_INIT is not set
CONFIG_CONSOLE_MUX=y
#CONFIG_OF_BOARD=y
CONFIG_SYS_TEXT_BASE=0x4A000000

#secure
CONFIG_SUNXI_SECURE_BOOT=y
CONFIG_SUNXI_IMAGE_VERIFIER=y
CONFIG_SUNXI_KEYBOX=y
CONFIG_SUNXI_DRM_SUPPORT=y
#system
CONFIG_ARM_SMCCC=y
CONFIG_SUNXI_DMA=y
CONFIG_PHYS_64BIT=y

#SPI
CONFIG_SPI=y
CONFIG_SUNXI_SPI=y
#CONFIG_SPI_USE_DMA=y
CONFIG_SPI_FLASH=y
CONFIG_SPI_FLASH_WINBOND=y
CONFIG_SPI_FLASH_EON=y
CONFIG_SPI_FLASH_GIGADEVICE=y
CONFIG_SPI_FLASH_ISSI=y
CONFIG_SPI_FLASH_MACRONIX=y
CONFIG_SPI_FLASH_SPANSION=y
CONFIG_SPI_FLASH_ATMEL=y
CONFIG_SPI_FLASH_STMICRO=y
CONFIG_SPI_FLASH_SST=y
CONFIG_SPI_FLASH_PUYA=y
CONFIG_SPI_FLASH_FM=y
CONFIG_SPI_FLASH_XMC=y

CONFIG_SF_DEFAULT_SPEED=50000000
# BIT(12) BIT(13) (SPI_RX_DUAL|SPI_RX_QUAD)
CONFIG_SF_DEFAULT_MODE=0x3000
CONFIG_SPINOR_UBOOT_OFFSET=128
CONFIG_SPINOR_LOGICAL_OFFSET=2016

# flash
CONFIG_SUNXI_SDMMC=y
CONFIG_MMC=y
CONFIG_SUNXI_FLASH=y
CONFIG_SUNXI_NAND=y
CONFIG_SUNXI_UBIFS=y
CONFIG_SUNXI_COMM_NAND_V1=y
CONFIG_SUNXI_SPINOR=y

#
# sunxi-nand
#
CONFIG_AW_MTD_SPINAND=y
# CONFIG_AW_MTD_RAWNAND is not set
CONFIG_AW_SPINAND_PHYSICAL_LAYER=y
CONFIG_AW_SPINAND_NONSTANDARD_SPI_DRIVER=y
# CONFIG_AW_SPINAND_ENABLE_PHY_CRC16 is not set
# CONFIG_AW_SPINAND_PSTORE_MTD_PART is not set
CONFIG_AW_MTD_SPINAND_UBOOT_BLKS=24
CONFIG_AW_SPINAND_SIMULATE_MULTIPLANE=y
# CONFIG_AW_MTD_SPINAND_OOB_RAW_SPARE is not set
CONFIG_AW_RAWNAND_SIMULATE_MULTIPLANE=y

#usb otg config
CONFIG_SUNXI_USB=y
CONFIG_SUNXI_EFEX=y
CONFIG_SUNXI_BURN=y

#partition
CONFIG_EFI_PARTITION=y
CONFIG_LAST_PARTITION_NAME="userdata"
CONFIG_SUNXI_UPDATE_GPT=y

#image
CONFIG_ANDROID_BOOT_IMAGE=y

#sprite
CONFIG_SUNXI_SPRITE=y
CONFIG_SUNXI_SECURE_STORAGE=y
CONFIG_SUNXI_SPRITE_CARTOON=y

#android
CONFIG_SUNXI_MAC=y
CONFIG_SUNXI_USER_KEY=y
CONFIG_SUNXI_AVB=y
CONFIG_SUNXI_ANDROID_BOOT=y
CONFIG_SUNXI_SERIAL=y
CONFIG_SUNXI_VERIFY_BOOT_INFO_INSTALL=y
CONFIG_ANDROID_AB=y

#cmd
CONFIG_CMD_SUNXI_TIMER=y
CONFIG_CMD_SUNXI_SPRITE=y
CONFIG_CMD_SUNXI_EFEX=y
CONFIG_CMD_SUNXI_BURN=y
CONFIG_CMD_GPT=y
CONFIG_CMD_FAT=y
CONFIG_CMD_SUNXI_MEMTEST=y
CONFIG_CMD_FASTBOOT=y
CONFIG_CMD_PART=y
CONFIG_CMD_AB_SELECT=y
CONFIG_CMD_SUNXI_BOOTRV=y


#overlay
CONFIG_SUNXI_ANDROID_OVERLAY=y

CONFIG_SUNXI_OTA_TURNNING=y


CONFIG_OF_SEPARATE=y
CONFIG_SUNXI_NECESSARY_REPLACE_FDT=y

CONFIG_PWM_NOT_USE=y
CONFIG_SUNXI_WDT_V2=y
CONFIG_SUNXI_GPIO_POWER_VOL_MODE=y
```

## longan/brandy/brandy-2.0/u-boot-2018/configs/sun60iw1p1_defconfig
```kconfig
CONFIG_ARM=y
CONFIG_ARCH_SUNXI=y
CONFIG_MACH_SUN60IW1=y
#CONFIG_AXP_GPIO=y
CONFIG_DEFAULT_DEVICE_TREE="sun60iw1p1-soc-system"
# CONFIG_SYS_MALLOC_CLEAR_ON_INIT is not set
CONFIG_CONSOLE_MUX=y
#CONFIG_OF_BOARD=y
CONFIG_SYS_TEXT_BASE=0x4A000000

#secure
CONFIG_SUNXI_SECURE_BOOT=y
CONFIG_SUNXI_IMAGE_VERIFIER=y
CONFIG_SUNXI_KEYBOX=y
CONFIG_SUNXI_CE_21=y
CONFIG_SUNXI_DRM_SUPPORT=y
#system
CONFIG_ARM_SMCCC=y
CONFIG_SUNXI_DMA=y
CONFIG_PHYS_64BIT=y

#I2C
CONFIG_SYS_I2C_SUNXI=y
CONFIG_SYS_SUNXI_R_I2C0_SLAVE=0x34
CONFIG_SYS_SUNXI_R_I2C0_SPEED=400000
CONFIG_R_I2C0_ENABLE=y
# #power
# CONFIG_SUNXI_POWER=y

# CONFIG_SUNXI_PMU=y
# CONFIG_SUNXI_BMU=y
# CONFIG_AXP81X_POWER=y
# CONFIG_AXP81X_SUNXI_I2C_SLAVE=0x34
# CONFIG_AXP858_POWER=y
# CONFIG_AXP858_SUNXI_I2C_SLAVE=0x36
# CONFIG_AXP806_POWER=y
# CONFIG_AXP806_SUNXI_I2C_SLAVE=0x36

# CONFIG_AXP2202_POWER=y
# CONFIG_AXP2202_SUNXI_I2C_SLAVE=0x34
# flash
CONFIG_SUNXI_SDMMC=y
CONFIG_MMC=y
CONFIG_SUNXI_FLASH=y
#CONFIG_SUNXI_NAND=y

#usb otg config
CONFIG_SUNXI_USB=y
CONFIG_SUNXI_EFEX=y
CONFIG_SUNXI_BURN=y

#partition
CONFIG_EFI_PARTITION=y

#image
CONFIG_ANDROID_BOOT_IMAGE=y

#sprite
CONFIG_SUNXI_SPRITE=y
CONFIG_SUNXI_SECURE_STORAGE=y
CONFIG_SUNXI_SPRITE_CARTOON=y

#android
CONFIG_SUNXI_MAC=y
CONFIG_SUNXI_USER_KEY=y
CONFIG_SUNXI_AVB=y
CONFIG_SUNXI_ANDROID_BOOT=y
CONFIG_SUNXI_SERIAL=y
CONFIG_SUNXI_VERIFY_BOOT_INFO_INSTALL=y
CONFIG_ANDROID_AB=y

#cmd
CONFIG_CMD_SUNXI_TIMER=y
CONFIG_CMD_SUNXI_SPRITE=y
CONFIG_CMD_SUNXI_EFEX=y
CONFIG_CMD_SUNXI_BURN=y
CONFIG_CMD_GPT=y
CONFIG_CMD_FAT=y
CONFIG_CMD_SUNXI_MEMTEST=y
CONFIG_CMD_FASTBOOT=y
CONFIG_CMD_PART=y

#
# Clock
#
#CONFIG_CLK_SUNXI=y

# BOOT GUI
#
CONFIG_BOOT_GUI=y
# CONFIG_UPDATE_DISPLAY_MODE is not set
# CONFIG_CONFIG_LCD_CHECK_SKIP_OPEN is not set
# CONFIG_BOOT_GUI_DOUBLE_BUF is not set
# CONFIG_BOOT_GUI_TEST is not set
CONFIG_OF_SEPARATE=y
CONFIG_SUNXI_NECESSARY_REPLACE_FDT=y

CONFIG_PWM_NOT_USE=y
```

## longan/brandy/brandy-2.0/u-boot-2018/configs/sun8iw21p1_fastboot_defconfig
```kconfig
CONFIG_ARM=y
CONFIG_ARCH_SUNXI=y
CONFIG_MACH_SUN8IW21=y
CONFIG_SUNXI_GPIO_V2=y
#CONFIG_AXP_GPIO=y
CONFIG_SYS_CONFIG_NAME="sun8iw21p1"
CONFIG_DEFAULT_DEVICE_TREE="sun8iw21p1-soc-system"
# CONFIG_SYS_MALLOC_CLEAR_ON_INIT is not set
CONFIG_CONSOLE_MUX=y
CONFIG_SUNXI_NECESSARY_REPLACE_FDT=y
CONFIG_RESERVE_FDT_SIZE=0x20000
CONFIG_PRE_CONSOLE_BUFFER=n
# CONFIG_OF_BOARD=y
CONFIG_OF_SEPARATE=y
CONFIG_SYS_TEXT_BASE=0x43000000
CONFIG_SUNXI_FDT_ADDR=0x41800000

#system
CONFIG_ARM_SMCCC=y
#CONFIG_SUNXI_DEBUG=y
CONFIG_SUNXI_DMA=y

#SPI
CONFIG_SPI=y
CONFIG_SUNXI_SPI=y
CONFIG_SPI_USE_DMA=y
CONFIG_SPI_FLASH=y
CONFIG_SPI_FLASH_WINBOND=y
CONFIG_SPI_FLASH_EON=y
CONFIG_SPI_FLASH_GIGADEVICE=y
CONFIG_SPI_FLASH_ISSI=y
CONFIG_SPI_FLASH_MACRONIX=y
CONFIG_SPI_FLASH_SPANSION=y
CONFIG_SPI_FLASH_ATMEL=y
CONFIG_SPI_FLASH_STMICRO=y
CONFIG_SPI_FLASH_SST=y
CONFIG_SPI_FLASH_PUYA=y
CONFIG_SPI_FLASH_FM=y
CONFIG_SPI_FLASH_XT=y
CONFIG_SPI_FLASH_ADESTO=y
CONFIG_SPI_FLASH_XMC=y
CONFIG_SPI_SAMP_DL_EN=y

CONFIG_SF_DEFAULT_SPEED=50000000
# BIT(12) BIT(13) (SPI_RX_DUAL|SPI_RX_QUAD)
CONFIG_SF_DEFAULT_MODE=0x3000
CONFIG_SPINOR_UBOOT_OFFSET=128
CONFIG_SPINOR_LOGICAL_OFFSET=4064



# flash
CONFIG_SUNXI_SDMMC=y
CONFIG_MMC=y
CONFIG_SUNXI_FLASH=y
#CONFIG_SUNXI_NAND=y
CONFIG_SUNXI_SPINOR=y
# CONFIG_SUNXI_NOR_IMG=y
CONFIG_SUNXI_SPIF=y

#usb otg config
CONFIG_SUNXI_USB=y
CONFIG_SUNXI_EFEX=y
#CONFIG_SUNXI_BURN=y
CONFIG_SUNXI_FASTBOOT=y
#partition
CONFIG_EFI_PARTITION=y


#image
CONFIG_ANDROID_BOOT_IMAGE=y

#sprite
CONFIG_SUNXI_SPRITE=y
# CONFIG_SUNXI_AUTO_UPDATE=y
CONFIG_SUNXI_PART_UPDATE=y

CONFIG_SUNXI_SPRITE_CARTOON=y

#cmd
CONFIG_CMD_SUNXI_TIMER=y
CONFIG_CMD_SUNXI_SPRITE=y
CONFIG_CMD_SUNXI_EFEX=y
CONFIG_CMD_SUNXI_BURN=y
CONFIG_CMD_FASTBOOT=y
CONFIG_CMD_GPT=y
CONFIG_CMD_FAT=y
CONFIG_CMD_SUNXI_DMA=y
CONFIG_CMD_SF=y
CONFIG_CMD_SF_TEST=y
CONFIG_CMD_PART=y
CONFIG_CMD_SUNXI_BOOTR=y

CONFIG_SUNXI_ARM_SOFT_FP=y
CONFIG_USE_PRIVATE_LIBGCC=y

#adc
# CONFIG_SUNXI_GPADC=y

#COMP
#CONFIG_SUNXI_COMP_GZ=y

# BOOT GUI
#
CONFIG_BOOT_GUI=y

#
# SUNXI LOGO DISPLAY
#
#
CONFIG_CMD_SUNXI_BMP=y
# CONFIG_SUNXI_SPINOR_BMP is not set
# CONFIG_ENABLE_ADVERT_PICTURE is not set
# CONFIG_SUNXI_SPINOR_JPEG is not set
# CONFIG_CMD_SUNXI_JPEG is not set
CONFIG_DISP2_SUNXI=y
# CONFIG_HDMI_DISP2_SUNXI is not set
# CONFIG_HDMI2_DISP2_SUNXI is not set
# CONFIG_VDPO_DISP2_SUNXI is not set
# CONFIG_TV_DISP2_SUNXI is not set
# CONFIG_EDP_DISP2_SUNXI is not set
# CONFIG_EINK200_SUNXI is not set

# clk for DE
CONFIG_CLK_SUNXI=y


# LCD panels select
#
CONFIG_LCD_SUPPORT_T050K589=y

# PWM_SUNXI
CONFIG_PWM_SUNXI=y
```

## longan/brandy/brandy-2.0/u-boot-2018/configs/sun8iw21p1_fastboot_nor_defconfig
```kconfig
CONFIG_ARM=y
CONFIG_ARCH_SUNXI=y
CONFIG_MACH_SUN8IW21=y
CONFIG_SUNXI_GPIO_V2=y
#CONFIG_AXP_GPIO=y
CONFIG_SYS_CONFIG_NAME="sun8iw21p1"
CONFIG_DEFAULT_DEVICE_TREE="sun8iw21p1-soc-system"
# CONFIG_SYS_MALLOC_CLEAR_ON_INIT is not set
CONFIG_CONSOLE_MUX=y
CONFIG_SUNXI_NECESSARY_REPLACE_FDT=y
CONFIG_RESERVE_FDT_SIZE=0x20000
CONFIG_PRE_CONSOLE_BUFFER=n
# CONFIG_OF_BOARD=y
CONFIG_OF_SEPARATE=y
CONFIG_SYS_TEXT_BASE=0x43000000
CONFIG_SUNXI_FDT_ADDR=0x41800000

#system
CONFIG_ARM_SMCCC=y
#CONFIG_SUNXI_DEBUG=y
CONFIG_SUNXI_DMA=y

#SPI
CONFIG_SPI=y
CONFIG_SUNXI_SPI=y
CONFIG_SPI_USE_DMA=y
CONFIG_SPI_FLASH=y
CONFIG_SPI_FLASH_WINBOND=y
CONFIG_SPI_FLASH_EON=y
CONFIG_SPI_FLASH_GIGADEVICE=y
CONFIG_SPI_FLASH_ISSI=y
CONFIG_SPI_FLASH_MACRONIX=y
CONFIG_SPI_FLASH_SPANSION=y
CONFIG_SPI_FLASH_ATMEL=y
CONFIG_SPI_FLASH_STMICRO=y
CONFIG_SPI_FLASH_SST=y
CONFIG_SPI_FLASH_PUYA=y
CONFIG_SPI_FLASH_FM=y
CONFIG_SPI_FLASH_XT=y
CONFIG_SPI_FLASH_ADESTO=y
CONFIG_SPI_FLASH_XMC=y
CONFIG_SPI_SAMP_DL_EN=y

CONFIG_SF_DEFAULT_SPEED=50000000
# BIT(12) BIT(13) (SPI_RX_DUAL|SPI_RX_QUAD)
CONFIG_SF_DEFAULT_MODE=0x3000
CONFIG_SPINOR_UBOOT_OFFSET=128
CONFIG_SPINOR_LOGICAL_OFFSET=4064



# flash
CONFIG_SUNXI_FLASH=y
#CONFIG_SUNXI_NAND=y
CONFIG_SUNXI_SPINOR=y
CONFIG_SUNXI_NOR_IMG=y
CONFIG_SUNXI_SPIF=y

#usb otg config
CONFIG_SUNXI_USB=y
CONFIG_SUNXI_EFEX=y
#CONFIG_SUNXI_BURN=y
CONFIG_SUNXI_FASTBOOT=y
#partition
CONFIG_EFI_PARTITION=y


#image
CONFIG_ANDROID_BOOT_IMAGE=y

#sprite
CONFIG_SUNXI_SPRITE=y
CONFIG_SUNXI_AUTO_UPDATE=y
CONFIG_SUNXI_PART_UPDATE=y

#cmd
CONFIG_CMD_SUNXI_TIMER=y
CONFIG_CMD_SUNXI_SPRITE=y
CONFIG_CMD_SUNXI_EFEX=y
CONFIG_CMD_SUNXI_BURN=y
CONFIG_CMD_FASTBOOT=y
CONFIG_CMD_GPT=y
CONFIG_CMD_FAT=y
CONFIG_CMD_SUNXI_DMA=y
CONFIG_CMD_SF=y
CONFIG_CMD_SF_TEST=y
CONFIG_CMD_PART=y
CONFIG_CMD_SUNXI_BOOTR=y

CONFIG_SUNXI_ARM_SOFT_FP=y
CONFIG_USE_PRIVATE_LIBGCC=y

#adc
# CONFIG_SUNXI_GPADC=y

#COMP
#CONFIG_SUNXI_COMP_GZ=y
```

## longan/brandy/brandy-2.0/u-boot-2018/drivers/mtd/awnand/Kconfig
```kconfig
config AW_MTD_SPINAND
	tristate "Allwinner MTD SPINAND Device Support"
	depends on ARCH_SUNXI
	select AW_SPINAND_PHYSICAL_LAYER
	select AW_SPINAND_NONSTANDARD_SPI_DRIVER
	select MTD_UBI
	select MTD_DEVICE
	select MTD_PARTITIONS
	select MTD_CMD_MTDPARTS
	select MTD_CMD_UBIFS
	select CMD_UBI
	select RBTREE
	select LZO
	help
	  Enables support for SPINAND Flash chips on Allwinner SoCs.
	  It's different with Allwinner's privately nand driver that it use
	  ubi system rather than Allwinner's NFTL.

config AW_MTD_RAWNAND
	tristate "Allwinner MTD RAWNAND(SLC) Device Support"
	depends on ARCH_SUNXI
	select SUNXI_UBIFS
	select SUNXI_NAND
	select SUNXI_COMM_NAND_V1
	select MTD_DEVICE
	select CMD_MTDPARTS
	select CMD_UBIFS
	select CMD_UBI
	select RBTREE
	select LZO
	help
	  Enables support for RAWNAND Flash chips on Allwinner SoCs.
	  It's different with Allwinner's privately nand driver that it use
	  ubi system rather than Allwinner's NFTL.

config RAW_KERNEL
	bool "Kernel images are stored on physical partitions"
	help
	  Enables support kernel images are stored on physical partitions.

config KERNEL_SIZE_BYTE
	int "Kernel image size(Byte)"
	depends on RAW_KERNEL
	default 0
	help
	  To accurately read the complete kernel image, you need to set
	  the kernel image size (in bytes) when using the RAW-boot function.

if AW_MTD_SPINAND
source "drivers/mtd/awnand/spinand/Kconfig"
endif

if AW_MTD_RAWNAND
source "drivers/mtd/awnand/rawnand/Kconfig"
endif
```

## longan/brandy/brandy-2.0/u-boot-2018/drivers/sunxi_crypto/sunxi_hash/Kconfig
```kconfig
config SUNXI_HASH_SOFTWARE
	bool "sunxi hash software calculation"
	depends on SHA256
	default n
```
